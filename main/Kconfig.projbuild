## main/Kconfig.projbuild
```kconfig
menu "Example Configuration"

    config STORE_HISTORY
        bool "Store command history in flash"
        default y
        help
            Linenoise line editing library provides functions to save and load
            command history. If this option is enabled, initalizes a FAT filesystem
            and uses it to store command history.

endmenu

menu "Bridge Configuration"

    choice ETH_UPLINK_TYPE
        prompt "Ethernet driver"
        default ETH_UPLINK_EMAC
        config ETH_UPLINK_EMAC
            bool "Internal EMAC (WT32-ETH01 / LAN8720)"
        config ETH_UPLINK_W5500
            bool "SPI Ethernet W5500 (ESP32-C3)"
    endchoice

    # --- Internal EMAC options (WT32-ETH01) ---

    config ETH_MDC_GPIO
        int "ETH MDC GPIO"
        default 23
        depends on ETH_UPLINK_EMAC

    config ETH_MDIO_GPIO
        int "ETH MDIO GPIO"
        default 18
        depends on ETH_UPLINK_EMAC

    config ETH_PHY_ADDR
        int "ETH PHY address"
        default 1
        depends on ETH_UPLINK_EMAC

    config ETH_PHY_POWER_GPIO
        int "ETH PHY power GPIO (-1 for none)"
        default 16
        depends on ETH_UPLINK_EMAC

    # --- W5500 SPI Ethernet options ---

    config ETH_SPI_HOST
        int "SPI host number (1=SPI2_HOST, 2=SPI3_HOST)"
        default 1
        depends on ETH_UPLINK_W5500

    config ETH_SPI_MISO_GPIO
        int "W5500 MISO GPIO"
        default 5
        depends on ETH_UPLINK_W5500

    config ETH_SPI_MOSI_GPIO
        int "W5500 MOSI GPIO"
        default 6
        depends on ETH_UPLINK_W5500

    config ETH_SPI_SCLK_GPIO
        int "W5500 SCLK GPIO"
        default 4
        depends on ETH_UPLINK_W5500

    config ETH_SPI_CS_GPIO
        int "W5500 CS (SCS) GPIO"
        default 7
        depends on ETH_UPLINK_W5500

    config ETH_SPI_INT_GPIO
        int "W5500 INT GPIO (-1 for polling mode)"
        default 3
        depends on ETH_UPLINK_W5500
        help
            -1 selects polling mode: the driver checks the W5500 every
            ETH_SPI_POLL_MS instead of waiting for the INT pin. Use it on
            boards where the INT line is not wired to the SoC.

    config ETH_SPI_POLL_MS
        int "W5500 polling period in ms (used when INT GPIO is -1)"
        default 2
        range 1 100
        depends on ETH_UPLINK_W5500

    config ETH_SPI_RST_GPIO
        int "W5500 RST GPIO (-1 to disable)"
        default 2
        depends on ETH_UPLINK_W5500

    config ETH_SPI_CLOCK_MHZ
        int "W5500 SPI clock speed (MHz)"
        default 27
        range 1 80
        depends on ETH_UPLINK_W5500
        help
            Upper bound for SPI clock; the driver rounds DOWN to the nearest
            divider of the 80 MHz APB clock. Achievable values: 80, 40, 26.67,
            20, 16, 13.33, 11.43, 10, ... MHz. Setting e.g. 25 rounds to 20;
            set 27 to land on 26.67.

    # --- Common ---

    config BRIDGE_FDB_MAX_ENTRIES
        int "Bridge FDB max dynamic entries"
        default 48
        range 4 256
        help
            Maximum number of dynamic entries in the bridge forwarding
            database (MAC address table). Each entry tracks a learned
            MAC address and its associated port. Increase if the bridge
            serves many devices.

endmenu

menu "Factory Default on Power Cycle"
    comment "This feature allows the device to reset to factory defaults if it is power-cycled a certain number of times within a time window."

    config POWER_CYCLE_RESET_ENABLED
        bool "Enable factory reset on power cycle"
        default y   

    config  POWER_CYCLE_RESET_COUNT
        int "Number of power cycles to trigger factory reset"
        default 5
        range 1 10
        depends on POWER_CYCLE_RESET_ENABLED

    config POWER_CYCLE_RESET_TIMEOUT_SEC
        int "Time window for power cycle detection (sec)"
        default 10
        range 1 60
        depends on POWER_CYCLE_RESET_ENABLED 
endmenu

menu "Factory Defaults"
    comment "Fallback values used when a setting is not stored in NVS"
    comment "(first boot / after factory_reset). Nothing is written to NVS."

    config DEFAULT_AP_SSID
        string "WiFi AP SSID"
        default "esp32-bridge"

    config DEFAULT_AP_PASSWORD
        string "WiFi AP password"
        default ""
        help
            Empty = open network. Otherwise WPA2/WPA3 requires 8-63 characters.

    config DEFAULT_WIFI_COUNTRY
        string "WiFi country code"
        default "01"
        help
            2-character ISO 3166 code (e.g. US, DE, AU). "01" = world-safe.

    config DEFAULT_HOSTNAME
        string "DHCP hostname"
        default "esp32-bridge"

    config DEFAULT_TX_POWER_DBM
        int "WiFi TX power in dBm (0 = max)"
        default 0
        range 0 20

    config DEFAULT_STATIC_IP
        string "Management static IP (empty = DHCP client)"
        default ""

    config DEFAULT_SUBNET_MASK
        string "Management subnet mask"
        default ""
        help
            Required if a static IP is set.

    config DEFAULT_GATEWAY
        string "Management gateway"
        default ""
        help
            Required if a static IP is set.

    config DEFAULT_DHCPS_ENABLED
        bool "Enable built-in DHCP server"
        default n

    config DEFAULT_DHCPS_START_IP
        string "DHCP pool start IP (empty = auto)"
        default ""

    config DEFAULT_DHCPS_END_IP
        string "DHCP pool end IP (empty = auto)"
        default ""

    config DEFAULT_DHCPS_LEASE_MIN
        int "DHCP lease time (minutes)"
        default 120
        range 1 65535

    config DEFAULT_DHCPS_DNS_IP
        string "DHCP DNS server offered to clients (empty = self)"
        default ""

    config DEFAULT_WEB_ENABLED
        bool "Enable web interface"
        default y

    config DEFAULT_WEB_PORT
        int "Web interface port"
        default 80
        range 1 65535

endmenu
```
